#include "Matrix2D.h"
#include <Arduino.h>

#define WAIT_US 0

char znaky[] = {

    0x00, 0x00, 0x00, 0x00, 0x00, 0x00, 0x00, 0x00,         //space
    0x18, 0x18, 0x18, 0x18, 0x00, 0x00, 0x18, 0x00,         //!
    0x66, 0x66, 0x66, 0x00, 0x00, 0x00, 0x00, 0x00,         //"
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    0xFF, 0xFF, 0xFF, 0xFF, 0xFF, 0xFF, 0xFF, 0xFF, 		    //debug
  };

Matrix2D::Matrix2D(){};

void Matrix2D::begin(int DISPLAY_NUM, int DATA_PIN, int CLK_PIN, int LAT_PIN, int RST_PIN){
  Matrix2D::DATAPIN = DATA_PIN;
  Matrix2D::CLKPIN = CLK_PIN;
  Matrix2D::LATPIN = LAT_PIN;
  Matrix2D::RSTPIN = RST_PIN;
  Matrix2D::DISPLAYNUM = DISPLAY_NUM;


  pinMode(DATAPIN, OUTPUT);
  pinMode(CLKPIN, OUTPUT);
  pinMode(LATPIN, OUTPUT);
  pinMode(RSTPIN, OUTPUT);


  //Serial.println("Setup complete");
}

void Matrix2D::displayChar(char znak) {
  if (znak == 0) return;
	znak = znak - 32;
  Serial.print(znak);
	//Serial.print(znak, DEC);
    
	for(int i = 7; i >= 0; i--)
  	{
   		MYshiftOut(DATAPIN,CLKPIN,LSBFIRST, znaky[i + znak*8]);
   		//Serial.println(znaky[i+ znak*8], BIN);
  	}
}

void Matrix2D::display(String value){

  Matrix2D::VALUE = value;

  pulsePin(RSTPIN, true);
  
  char buffer[10];
  // clear buffer
  for (int i=0; i<DISPLAYNUM; i++) {
  	buffer[i] = 32;
  }
  
  // read data to display
  //int index = 0;
  //for (int i = 0; i <= DISPLAYNUM; i++) {          //change this!!!
    VALUE.toCharArray(buffer, 10);                              //and this
  //}
  
  // display data
  for (int i=DISPLAYNUM; i >=0; i--)
  {
    displayChar(buffer[i]);
  }
  pulsePin(LATPIN, false);
}


void Matrix2D::MYshiftOut(uint8_t DATAPIN, uint8_t CLKPIN, uint8_t bitOrder, uint8_t val){
  uint8_t i;
  
  digitalWrite(CLKPIN, LOW);

  for (i = 0; i < 8; i++)  {
    if (bitOrder == LSBFIRST) {
      digitalWrite(DATAPIN, val & 1);
      val >>= 1;
    } else {  
      digitalWrite(DATAPIN, (val & 128) != 0);
      val <<= 1;
    }
      
    delayMicroseconds(WAIT_US); 
    digitalWrite(CLKPIN, HIGH);
    delayMicroseconds(WAIT_US); 
    digitalWrite(CLKPIN, LOW); 
    delayMicroseconds(WAIT_US); 
  }
}

void Matrix2D::pulsePin(uint8_t pin, bool negative){
  if (!negative) {
    delayMicroseconds(WAIT_US);
    digitalWrite(pin, HIGH);
    delayMicroseconds(WAIT_US); 
    digitalWrite(pin, LOW); 
    delayMicroseconds(WAIT_US);          
  } else {
    delayMicroseconds(WAIT_US);
    digitalWrite(pin, LOW);
    delayMicroseconds(WAIT_US); 
    digitalWrite(pin, HIGH); 
    delayMicroseconds(WAIT_US);          
  }
}
